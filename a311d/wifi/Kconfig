## a311d/wifi/Kconfig
```kconfig
# SPDX-License-Identifier: GPL-2.0

config DRIVERS_HDF_NETDEV_EXT
    bool "Get Linux net device from HDF"
        default n
        help
          Get Linux net device from HDF

config RTL8822CS_WIFI_HDF
    tristate "support rtl8822cs wifi(80211ac) HDF"
    depends on DRIVERS_HDF_WIFI
        select CFG80211
        select MAC80211
        select DRIVERS_HDF_NETDEV_EXT
    help
      This driver supports wifi for rtl8822cs HDF chipset.
      This driver uses the kernel's wireless extensions subsystem.
      If you choose to build a module, it'll be called rtl8822cs. Say M if unsure.
```

## unionpi_tiger/kernel/drivers/Kconfig
```kconfig
# SPDX-License-Identifier: GPL-2.0

source "vendor/drivers/battery/Kconfig"
source "vendor/drivers/bluetooth/Kconfig"
source "vendor/drivers/panel/Kconfig"
source "vendor/drivers/rtl88x2cs/Kconfig"
source "vendor/drivers/wifi/Kconfig"
source "vendor/drivers/media/Kconfig"
```

## unionpi_tiger/kernel/drivers/battery/Kconfig
```kconfig
config AMLOGIC_BATTERY
	bool "Amlogic Battery support"
	default y
	help
		select y to support amlogic battery
```

## unionpi_tiger/kernel/drivers/bluetooth/Kconfig
```kconfig
config AMLOGIC_BLUETOOTH
    bool "Bluetooth Device support"
    default n
    help
      Say Y here if you want to use the BT device.
```

## unionpi_tiger/kernel/drivers/panel/Kconfig
```kconfig
# SPDX-License-Identifier: GPL-2.0-only
#
# Amlogic driver configuration
#
config AMLOGIC_DRM_PANEL
	bool "Amlogic DRM panel drivers"
	default n
	help
		this option is provided for control amlogic Panel
		drivers, if you want to use amlogic driver
		please open it

config DRM_PANEL_CHIPONE_ICN6211
	tristate "Chipone ICN6211 panel driver"
	depends on OF
	depends on DRM_MIPI_DSI
	depends on AMLOGIC_DRM_PANEL
	help
	  Say Y here if you want to enable support for the Chipone
	  ICN6211 controller for 800x480 LCD panels with MIPI-DSI-RGB
	  system interfaces, with 2 lane.
```

## unionpi_tiger/kernel/drivers/rtl88x2cs/Kconfig
```kconfig
config RTL8822CS
	tristate "Realtek 8822C SDIO WiFi"
	select WIRELESS_EXT
	select WEXT_PRIV
	help
	  Help message of RTL8822CS
```
